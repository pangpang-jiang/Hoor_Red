## CMakeLists.txt
```
cmake_minimum_required(VERSION 3.20.0)

find_package(Zephyr REQUIRED HINTS $ENV{ZEPHYR_BASE})
project(scu)

include_directories(
                    scu_sensors
                    src
)


FILE(GLOB app_sources src/*.c)
target_sources(app PRIVATE 
                        src/main.c
                        scu_sensors/scu_sensors.c
)
```

## prj.conf
```kconfig
CONFIG_NEWLIB_LIBC=y
CONFIG_CPLUSPLUS=y
CONFIG_LIB_CPLUSPLUS=y
CONFIG_STD_CPP17=y
CONFIG_MAIN_STACK_SIZE=2048
CONFIG_FPU=y
CONFIG_STDOUT_CONSOLE=y
CONFIG_I2C=y
CONFIG_SPI=y
CONFIG_SENSOR=y
CONFIG_LSM6DSL_TRIGGER_GLOBAL_THREAD=y
CONFIG_CBPRINTF_FP_SUPPORT=y
CONFIG_GPIO=y
CONFIG_BT_HOST_CCM=y
CONFIG_LIS3MDL_TRIGGER_OWN_THREAD=y
CONFIG_SERIAL=y
CONFIG_UART_INTERRUPT_DRIVEN=y
```

## src/main.c
```c
#include <zephyr/kernel.h>
#include <stdio.h>
#include <zephyr/sys/printk.h>
#include <math.h>
#include <zephyr/drivers/sensor.h>
#include <zephyr/device.h>
#include <zephyr/drivers/gpio.h>
#include <zephyr/sys/util.h>
#include <inttypes.h>
#include <scu_sensors.h>
#include <zephyr/drivers/pwm.h>
#include <zephyr/sys_clock.h>
#include <limits.h>
#include <zephyr/sys/time_units.h>
#include <zephyr/drivers/uart.h>
#include <string.h>



#define NUM_THREADS 50
#define STACK_SIZE (1024)
#define ANGLE_TIME 2000
K_THREAD_STACK_ARRAY_DEFINE(tstacks, NUM_THREADS, STACK_SIZE);
static struct k_thread t[NUM_THREADS];

void pitch_roll_main(){
    const struct device *const lsm6dsl_dev = DEVICE_DT_GET_ONE(st_lsm6dsl);
	while(1){
		int data = pitch_roll(lsm6dsl_dev);
		uart_process(data);
		k_sleep(K_MSEC(ANGLE_TIME));
	}
}
void hcsr04_main(){
	while (1) {
		hcsr04_alttitude();
    	k_sleep(K_SECONDS(2));
	}
}
void pressure_alltitude_main(){
	const struct device *const dev = DEVICE_DT_GET_ONE(st_lps22hb_press);
	while (1) {
		pressure_alttitude(dev);
		k_sleep(K_MSEC(2000));
	}
}

void main(void){
    k_tid_t tid[NUM_THREADS];
	tid[0] =
		k_thread_create(&t[0], tstacks[0], STACK_SIZE,
				hcsr04_main, NULL, NULL,
				NULL, K_PRIO_PREEMPT(10), 0, K_NO_WAIT);
	tid[1] =
		k_thread_create(&t[1], tstacks[1], STACK_SIZE,
				pitch_roll_main, NULL, NULL,
				NULL, K_PRIO_PREEMPT(10), 0, K_NO_WAIT);

	tid[2] =
		k_thread_create(&t[2], tstacks[2], STACK_SIZE,
				pressure_alltitude_main, NULL, NULL,
				NULL, K_PRIO_PREEMPT(10), 0, K_NO_WAIT);				
}
```
